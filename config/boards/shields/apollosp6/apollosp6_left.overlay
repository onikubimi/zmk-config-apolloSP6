#include "apollosp6.dtsi"

&kscan0 {
        diode-direction = "col2row";
        
        row-gpios
            = <&gpio0  6  (GPIO_ACTIVE_HIGH | GPIO_PULL_DOWN)>   // R0 006
            , <&gpio0  8  (GPIO_ACTIVE_HIGH | GPIO_PULL_DOWN)>   // R1 008
            , <&gpio1  0  (GPIO_ACTIVE_HIGH | GPIO_PULL_DOWN)>   // R2 100
            , <&gpio0 11  (GPIO_ACTIVE_HIGH | GPIO_PULL_DOWN)>   // R3 011
            , <&gpio1  4  (GPIO_ACTIVE_HIGH | GPIO_PULL_DOWN)>   // R4 104
            , <&gpio1  6  (GPIO_ACTIVE_HIGH | GPIO_PULL_DOWN)>;  // R5 106

        col-gpios
            = <&gpio0 17 GPIO_ACTIVE_HIGH>   // C0 017
            , <&gpio0 20 GPIO_ACTIVE_HIGH>   // C1 020
            , <&gpio0 22 GPIO_ACTIVE_HIGH>   // C2 022
            , <&gpio0 24 GPIO_ACTIVE_HIGH>   // C3 024
            , <&gpio0  9 GPIO_ACTIVE_HIGH>   // C4 009
            , <&gpio0 10 GPIO_ACTIVE_HIGH>   // C5 010
            , <&gpio1 11 GPIO_ACTIVE_HIGH>   // C6 111
            , <&gpio1 13 GPIO_ACTIVE_HIGH>   // C7 113
            , <&gpio1 15 GPIO_ACTIVE_HIGH>   // C8 115
            , <&gpio0  2 GPIO_ACTIVE_HIGH>   // C9 002
            , <&gpio0 29 GPIO_ACTIVE_HIGH>;  // C10 029
};
