## config/boards/shields/apollosp6/Kconfig.shield
```kconfig
config SHIELD_APOLLOSP6_LEFT
    def_bool $(shields_list_contains,apollosp6_left)

config SHIELD_APOLLOSP6_RIGHT
    def_bool $(shields_list_contains,apollosp6_right)
```
