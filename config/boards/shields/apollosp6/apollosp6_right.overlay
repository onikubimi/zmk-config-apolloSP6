#include "apollosp6.dtsi"

&default_transform {
    col-offset = <8>;
};

&kscan0 {
    diode-direction = "col2row";
    
    row-gpios
        = <&gpio0  6 (GPIO_ACTIVE_HIGH | GPIO_PULL_DOWN)>   // R0 006
        , <&gpio0  8 (GPIO_ACTIVE_HIGH | GPIO_PULL_DOWN)>   // R1 008
        , <&gpio1 13 (GPIO_ACTIVE_HIGH | GPIO_PULL_DOWN)>   // R2 113
        , <&gpio0 11 (GPIO_ACTIVE_HIGH | GPIO_PULL_DOWN)>   // R3 011
        , <&gpio1  4 (GPIO_ACTIVE_HIGH | GPIO_PULL_DOWN)>   // R4 104
        , <&gpio1  6 (GPIO_ACTIVE_HIGH | GPIO_PULL_DOWN)>;  // R5 106

    col-gpios
        = <&gpio0 31 GPIO_ACTIVE_HIGH>   // 列8
        , <&gpio0 29 GPIO_ACTIVE_HIGH>   // 列9
        , <&gpio0  2 GPIO_ACTIVE_HIGH>   // 列10
        , <&gpio1 15 GPIO_ACTIVE_HIGH>   // 列11
        , <&gpio0 24 GPIO_ACTIVE_HIGH>   // 列12
        , <&gpio0 22 GPIO_ACTIVE_HIGH>   // 列13
        , <&gpio0 20 GPIO_ACTIVE_HIGH>   // 列14
        , <&gpio0 17 GPIO_ACTIVE_HIGH>;  // 列15
};
